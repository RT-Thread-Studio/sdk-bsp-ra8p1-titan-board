## project/Titan_Openmv/Kconfig
```kconfig
mainmenu "Titan Board OpenMV configuration"

config BSP_DIR
    string
    option env="BSP_ROOT"
    default "."

config RTT_DIR
    string
    option env="RTT_ROOT"
    default "rt-thread"

config SDK_LIB_DIR
    string
    option env="TITAN_OPENMV_SDK_LIB_ROOT"
    default "libraries"

# All sources are already present in this SDK. No mklinks or package download.
# Earlier defaults take precedence over the SDK's generic 1 KiB MMC stack.
if BSP_OPENMV_STORAGE_SD
    config RT_MMCSD_STACK_SIZE
        default 4096
endif

source "$BSP_DIR/platform/port/storage_kconfig/Kconfig.rtthread"
source "$SDK_LIB_DIR/Kconfig"
source "$BSP_DIR/platform/port/storage_kconfig/Kconfig.board"

menu "Titan Board OpenMV port"
    config BSP_USING_OPENMV
        bool "Enable Titan Board OpenMV runtime"
        default y
        select RT_USING_COMPONENTS_INIT
        select RT_USING_USER_MAIN
        select RT_USING_SEMAPHORE
        select RT_USING_MUTEX
        select RT_USING_MESSAGEQUEUE
        select RT_USING_CPLUSPLUS
        select RT_USING_DFS
        select DFS_USING_POSIX
        select DFS_USING_WORKDIR
        select RT_USING_DFS_DEVFS
        select RT_USING_DFS_ELMFAT
        select RT_DFS_ELM_REENTRANT
        select RT_USING_POSIX_FS
        select RT_USING_POSIX_DEVIO
        select RT_USING_POSIX_POLL
        select RT_USING_POSIX_SELECT
        select PKG_USING_TINYUSB
        select BSP_USING_HYPERRAM
        select BSP_USING_GPIO
        help
            MicroPython, OpenMV and TinyUSB use the pinned local ThirdParty
            sources. The filesystem root and USB MSC expose the SD card. CDC remains available without media.
            OpenMV ml.Model and Ethos-U55 are always enabled by the fixed
            configuration in rtconfig_project.h.
            This project uses DFS v1. The generic FSP USB, CEU and online
            package implementations are not part of this port.

    if BSP_USING_OPENMV
        config BSP_OPENMV_STORAGE_SD
            bool
            default y
            select BSP_USING_SDHI
            select BSP_USING_SDHI0
            help
                SDHI0 provides the root FAT filesystem, openmv-vision.bin and
                USB MSC. Missing media does not prevent USB IDE access.
                The card is never formatted automatically.

        config OPENMV_HEAP_SIZE
            int
            default 1507328
            help
                This is the internal SRAM pool. Additional GC/image pools,
                DTCM VM stack and ITCM code are fixed by ra8_memory.h and
                board/linker_scripts/fsp.ld.

        config OPENMV_JPEG_BUF_SIZE
            int "OpenMV JPEG work buffer size (bytes)"
            range 16384 262144
            default 32768

        comment "OpenMV + Ethos-U55, 1472 KiB SRAM GC"
        comment "Required DFS v1 / FAT / POSIX and local TinyUSB are selected"
    endif

    config PKG_USING_TINYUSB
        bool "Use project-local TinyUSB CDC + MSC composite device"
        default y
        select RT_USING_SEMAPHORE
        select RT_USING_MUTEX
        select RT_USING_MESSAGEQUEUE
        help
            This symbol keeps the RT-Thread package naming convention.
            The source is ThirdParty/tinyusb and no package manager is used.

    if PKG_USING_TINYUSB
        config PKG_TINYUSB_STACK_SIZE
            int
            default 4096
        config PKG_TINYUSB_THREAD_PRIORITY
            int
            default 15
        config PKG_TINYUSB_RHPORT_NUM
            int "USB controller: 0 = FS, 1 = HS"
            range 0 1
            default 1
            help
                P413 switches the single board USB connector to this controller.
                HS is the default for OpenMV IDE framebuffer preview.
        config PKG_TINYUSB_HIGH_SPEED
            bool
            default y if PKG_TINYUSB_RHPORT_NUM = 1
        config PKG_TINYUSB_DEVICE_PORT_SPEED
            hex
            default 0x0400 if PKG_TINYUSB_RHPORT_NUM = 1
            default 0x0200
        config PKG_TINYUSB_DEVICE_ENABLE
            bool
            default y
        config PKG_TINYUSB_DEVICE_VID
            hex
            default 0x37C5
        config PKG_TINYUSB_DEVICE_PID
            hex
            default 0x16E3
        config PKG_TINYUSB_DEVICE_MANUFACTURER
            string
            default "OpenMV"
        config PKG_TINYUSB_DEVICE_PRODUCT
            string
            default "OpenMV AE3"
        config PKG_TINYUSB_EDPT0_SIZE
            int
            default 64
        config PKG_TINYUSB_DEVICE_CURRENT
            int
            default 250
        config PKG_TINYUSB_DEVICE_CDC
            bool
            default y
        config PKG_TINYUSB_DEVICE_MSC
            bool
            default y
        config PKG_TINYUSB_DEVICE_CDC_RX_BUFSIZE
            int "USB CDC receive buffer (bytes)"
            range 512 16384
            default 2048
        config PKG_TINYUSB_DEVICE_CDC_TX_BUFSIZE
            int
            default 2048
    endif
endmenu
```

## project/Titan_Openmv/platform/port/storage_kconfig/Kconfig.board
```kconfig
# Hardware resources reserved by the Titan Board OpenMV application.
menu "Titan Board hardware"
    config SOC_R7KA8P1KF
        bool
        default y
        select SOC_SERIES_R7KA8P1_CORE0
    config BSP_USING_GPIO
        bool
        default y
        select RT_USING_PIN
    config BSP_USING_UART
        bool
        default y
        select RT_USING_SERIAL
    config BSP_USING_UART8
        bool
        default y
    config BSP_UART8_RX_BUFSIZE
        int
        default 256
    config BSP_UART8_TX_BUFSIZE
        int
        default 0
    config BSP_USING_HW_I2C
        bool
        default y
        select RT_USING_I2C
    config BSP_USING_HW_I2C0
        bool
        default y
    config BSP_USING_HW_I2C1
        bool "Enable I2C1 on P511/P512 (CEU connector)"
        default y
    config BSP_USING_HYPERRAM
        bool
        default y
    config BSP_USING_HYPERRAM_SIZE
        hex
        default 0x02000000
    config BSP_USING_SDHI
        bool
        select RT_USING_SDIO
    config BSP_USING_SDHI0
        bool
    config BSP_SDHI0_BUS_WIDTH
        int
        default 1
    config BSP_USING_MIPI_CSI_CAMERA
        bool
        default y
    config BSP_USING_MIPI_CSI_CAMERA_I2C
        string
        default "i2c0"
endmenu
```

## project/Titan_Openmv/platform/port/storage_kconfig/Kconfig.components
```kconfig
# Project-maintained storage selection view; SDK sources remain unchanged.
menu "RT-Thread Components"

config RT_USING_COMPONENTS_INIT
    bool
    default n

config RT_USING_USER_MAIN
    bool
    default n

    if RT_USING_USER_MAIN
        config RT_MAIN_THREAD_STACK_SIZE
            int "Set main thread stack size"
            default 6144 if ARCH_CPU_64BIT
            default 2048

        config RT_MAIN_THREAD_PRIORITY
            int "Set main thread priority"
            default 4   if RT_THREAD_PRIORITY_8
            default 10  if RT_THREAD_PRIORITY_32
            default 85  if RT_THREAD_PRIORITY_256
    endif

config RT_USING_LEGACY
    bool "Support legacy version for compatibility"
    default n

if RT_USING_CONSOLE
source "$RTT_DIR/components/finsh/Kconfig"
endif

if !RT_USING_NANO
source "$RTT_DIR/components/dfs/Kconfig"
source "$BSP_DIR/platform/port/storage_kconfig/Kconfig.fal"
source "$BSP_DIR/platform/port/storage_kconfig/Kconfig.drivers"
source "$RTT_DIR/components/libc/Kconfig"
source "$RTT_DIR/components/net/Kconfig"
source "$RTT_DIR/components/mprotect/Kconfig"
source "$RTT_DIR/components/utilities/Kconfig"
source "$RTT_DIR/components/vbus/Kconfig"
endif

if RT_USING_SMART
source "$RTT_DIR/components/lwp/Kconfig"
source "$RTT_DIR/components/mm/Kconfig"
endif
endmenu
```
