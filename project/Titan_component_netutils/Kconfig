## project/Titan_component_netutils/Kconfig
```kconfig
mainmenu "RT-Thread Configuration"

BSP_DIR := .

RTT_DIR := rt-thread

# you can change the RTT_ROOT default "../.." to your rtthread_root,
# example : default "F:/git_repositories/rt-thread"

PKGS_DIR := packages

ENV_DIR := /

config PLATFORM_DIR
    string
    option env="PLATFORM_DIR"
    default "C:/Users/RTT/Desktop/PR/sdk-bsp-ra8p1-titan-board/project/Titan_component_netutils/platform"

config RTT_DIR
    string
    option env="RTT_DIR"
    default "C:/Users/RTT/Desktop/PR/sdk-bsp-ra8p1-titan-board/project/Titan_component_netutils/rt-thread"

config PKGS_DIR
    string
    option env="PKGS_DIR"
    default "C:/Softwares/RT-ThreadStudio/platform/env_released/env/packages"

source "$(RTT_DIR)/Kconfig"
source "$PKGS_DIR/Kconfig"
source "libraries/Kconfig"
source "$(BSP_DIR)/board/Kconfig"
```

## project/Titan_driver_wifi/Kconfig
```kconfig
mainmenu "RT-Thread Configuration"

BSP_DIR := .

RTT_DIR := rt-thread

# you can change the RTT_ROOT default "../.." to your rtthread_root,
# example : default "F:/git_repositories/rt-thread"

PKGS_DIR := packages

ENV_DIR := /

config PLATFORM_DIR
    string
    option env="PLATFORM_DIR"
    default "E:/Desktop/ra8p1/project/Titan_driver_wifi/platform"

config RTT_DIR
    string
    option env="RTT_DIR"
    default "E:/Desktop/ra8p1/project/Titan_driver_wifi/rt-thread"

config PKGS_DIR
    string
    option env="PKGS_DIR"
    default "D:/RT-ThreadStudio/platform/env_released/env/packages"

source "$(RTT_DIR)/Kconfig"
osource "$PKGS_DIR/Kconfig"
rsource "libraries/Kconfig"
source "$(BSP_DIR)/board/Kconfig"
```
